# file: lession.ioc
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Mcu.Family=STM32F4
Mcu.Name=STM32F411V(C-E)Tx
Mcu.Package=LQFP100
NVIC.PriorityGroup=NVIC_PRIORITYGROUP_4
PA13.Mode=Serial_Wire
PA13.Signal=SYS_JTMS-SWDIO
PA14.Mode=Serial_Wire
PA14.Signal=SYS_JTCK-SWCLK
ProjectManager.HeapSize=0x200
ProjectManager.StackSize=0x400
ProjectManager.TargetToolchain=STM32CubeIDE
RCC.AHBFreq_Value=16000000
RCC.APB1Freq_Value=16000000
RCC.APB2Freq_Value=16000000
RCC.CortexFreq_Value=16000000
RCC.HSE_VALUE=25000000
RCC.HSI_VALUE=16000000
RCC.LSE_VALUE=32768
RCC.SYSCLKFreq_VALUE=16000000
RCC.VCOOutputFreq_Value=192000000
board=custom

// file: Core/Src/main.c
/* USER CODE BEGIN Header */
/**
  ******************************************************************************
  * @file           : main.c
  * @brief          : Main program body
  ******************************************************************************
  * @attention
  *
  * Copyright (c) 2023 STMicroelectronics.
  * All rights reserved.
  *
  * This software is licensed under terms that can be found in the LICENSE file
  * in the root directory of this software component.
  * If no LICENSE file comes with this software, it is provided AS-IS.
  *
  ******************************************************************************
  */
/* USER CODE END Header */
#include "main.h"

/* USER CODE BEGIN PTD */
typedef enum
{
	LED0, LED1, LED2, LED3
}LED_NUMBER_t;

typedef enum
{
	LED_OFF, LED_ON
}LED_STATE_t;

typedef enum
{
	pBRelease, pBPress
}PB_STATE;
/* USER CODE END PTD */

/* USER CODE BEGIN PD */
#define LED_GREEN	(1U << 12)
#define LED_ORANGE	(1U << 13)
#define LED_RED		(1U << 14)
#define LED_BLUE	(1U << 15)
#define BUTTON		(*((uint32_t*)(0x40020000 + 0x10)) & 1U)
#define GPIOD_MODER		(*((uint32_t*)(0x40020C00 | 0x00)))	// GPIO port D mode select register
#define GPIOD_OTYPER	(*((uint32_t*)(0x40020C00 | 0x04)))	// GPIO port D output type register
#define GPIOD_ODR		(*((uint32_t*)(0x40020C00 | 0x14)))	// GPIO port D output data register

#define GPIOA_MODER		(*((uint32_t*)(0x40020000 | 0x00)))	// GPIO port A mode select register
#define GPIOA_IDR		(*((uint32_t*)(0x40020000 | 0x10)))	// GPIO port A input data register
#define GPIOA_PUPDR		*((uint32_t*)(0x40020000 | 0x0C))	// GPIO port A pull-up/pull-down register

#define EXTI_IMR		(*((uint32_t*)(0x40013C00 | 0x00)))	// Interrupt mask register
#define EXTI_RTSR		(*((uint32_t*)(0x40013C00 | 0x08)))	// Rising trigger selection register
#define EXTI_PR			(*((uint32_t*)(0x40013C00 | 0x14)))	// Pending register

#define NVIC_ISER0		(*((uint32_t*)(0xE000E100 | 0x00)))	// Interrupt set-enable register 0
/* USER CODE END PD */

void SystemClock_Config(void);

/* USER CODE BEGIN 0 */
void ledInit()
{
	__HAL_RCC_GPIOD_CLK_ENABLE();		// Enable clock for GPIOD
	/*
	 * to do:
	 * set PD12, PD13, PD14, PD15 in OUTPUT MODE (push-pull)
	 */
	GPIOD_MODER &= ~(0xFF << 24);		// Clear
	GPIOD_MODER |= (0b01 << 24) | (0b01 << 26) | (0b01 << 28) | (0b01 << 30);

	GPIOD_OTYPER &= ~(0b1111 << 12);
}

void ledCtrl(LED_NUMBER_t ledNumber, LED_STATE_t ledState)
{
//	uint32_t *GPIOD_ODR	= (uint32_t*)(0x40020C00 + 0x14);
	if(ledState == LED_ON)
	{
		GPIOD_ODR |= LED_GREEN << ledNumber;
	}
	else
	{
		GPIOD_ODR &= ~(LED_GREEN << ledNumber);
	}
}

void buttonInit()
{
	__HAL_RCC_GPIOA_CLK_ENABLE();	// Enable clock for GPIOA
	/*
	 * to do:
	 * set PA0 is input (no pull up no pull down)
	 */
	GPIOA_MODER &= ~(3U);		// PA0 as input
	GPIOA_PUPDR &= ~(3U);		// No pull up, no pull down

}

void extiOInit()
{
	EXTI_IMR |= 1U << 0;
	EXTI_RTSR |= 1U << 0;
	NVIC_ISER0 |= 1U << 6;
}

void EXTI0_IRQHandler()
{
	ledCtrl(LED1, LED_OFF);
	ledCtrl(LED2, LED_OFF);
	ledCtrl(LED3, LED_ON);
	HAL_Delay(1000);
	EXTI_PR |= 1U << 0;
}
/* USER CODE END 0 */

int main(void)
{

  /* MCU Configuration--------------------------------------------------------*/

  /* Reset of all peripherals, Initializes the Flash interface and the Systick. */
  HAL_Init();

  /* Configure the system clock */
  SystemClock_Config();

  /* Initialize all configured peripherals */
  /* USER CODE BEGIN 2 */
  ledInit();
  buttonInit();
  extiOInit();
  /* USER CODE END 2 */

  /* Infinite loop */
  while (1)
  {
//	  if(BUTTON == pBPress)
//		  ledCtrl(LED3, LED_ON);
//	  else
//	  {
//		HAL_Delay(2000);
		ledCtrl(LED3, LED_OFF);
		ledCtrl(LED1, LED_ON);
		ledCtrl(LED2, LED_ON);
//		  ledCtrl(LED0, LED_OFF);
//	  }
  }
}

void SystemClock_Config(void)
{
  RCC_OscInitTypeDef RCC_OscInitStruct = {0};
  RCC_ClkInitTypeDef RCC_ClkInitStruct = {0};

  /** Configure the main internal regulator output voltage
  */
  __HAL_RCC_PWR_CLK_ENABLE();
  __HAL_PWR_VOLTAGESCALING_CONFIG(PWR_REGULATOR_VOLTAGE_SCALE1);

  /** Initializes the RCC Oscillators according to the specified parameters
  * in the RCC_OscInitTypeDef structure.
  */
  RCC_OscInitStruct.OscillatorType = RCC_OSCILLATORTYPE_HSI;
  RCC_OscInitStruct.HSIState = RCC_HSI_ON;
  RCC_OscInitStruct.HSICalibrationValue = RCC_HSICALIBRATION_DEFAULT;
  RCC_OscInitStruct.PLL.PLLState = RCC_PLL_NONE;
  if (HAL_RCC_OscConfig(&RCC_OscInitStruct) != HAL_OK)
  {
    Error_Handler();
  }

  /** Initializes the CPU, AHB and APB buses clocks
  */
  RCC_ClkInitStruct.ClockType = RCC_CLOCKTYPE_HCLK|RCC_CLOCKTYPE_SYSCLK
                              |RCC_CLOCKTYPE_PCLK1|RCC_CLOCKTYPE_PCLK2;
  RCC_ClkInitStruct.SYSCLKSource = RCC_SYSCLKSOURCE_HSI;
  RCC_ClkInitStruct.AHBCLKDivider = RCC_SYSCLK_DIV1;
  RCC_ClkInitStruct.APB1CLKDivider = RCC_HCLK_DIV1;
  RCC_ClkInitStruct.APB2CLKDivider = RCC_HCLK_DIV1;

  if (HAL_RCC_ClockConfig(&RCC_ClkInitStruct, FLASH_LATENCY_0) != HAL_OK)
  {
    Error_Handler();
  }
}

void Error_Handler(void)
{
  __disable_irq();
  while (1)
  {
  }
}
