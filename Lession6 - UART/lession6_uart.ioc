# file: lession6_uart.ioc
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Mcu.Family=STM32F4
Mcu.Name=STM32F411V(C-E)Tx
Mcu.Package=LQFP100
NVIC.PriorityGroup=NVIC_PRIORITYGROUP_4
PA13.Mode=Serial_Wire
PA13.Signal=SYS_JTMS-SWDIO
PA14.Mode=Serial_Wire
PA14.Signal=SYS_JTCK-SWCLK
ProjectManager.HeapSize=0x200
ProjectManager.StackSize=0x400
ProjectManager.TargetToolchain=STM32CubeIDE
RCC.AHBFreq_Value=16000000
RCC.APB1Freq_Value=16000000
RCC.APB2Freq_Value=16000000
RCC.CortexFreq_Value=16000000
RCC.HSE_VALUE=25000000
RCC.HSI_VALUE=16000000
RCC.LSE_VALUE=32768
RCC.SYSCLKFreq_VALUE=16000000
RCC.VCOOutputFreq_Value=192000000
board=custom

// file: Core/Src/main.c
/* USER CODE BEGIN Header */
/**
  ******************************************************************************
  * @file           : main.c
  * @brief          : Main program body
  ******************************************************************************
  * @attention
  *
  * Copyright (c) 2023 STMicroelectronics.
  * All rights reserved.
  *
  * This software is licensed under terms that can be found in the LICENSE file
  * in the root directory of this software component.
  * If no LICENSE file comes with this software, it is provided AS-IS.
  *
  ******************************************************************************
  */
/* USER CODE END Header */
#include "main.h"

/* USER CODE BEGIN PD */
#define GPIOA_MODER		(*((uint32_t*)(0x40020000 | 0x00)))	// GPIO port A mode select register
#define GPIOA_AFRL		(*((uint32_t*)(0x40020000 | 0x20)))	// GPIO alternate function low register
#define CR1				(*((uint32_t*)(0x4000440C)))	//
#define BRR				(*((uint32_t*)(0x40004408)))	//
#define DR				(*((uint32_t*)(0x40004404)))	//
#define SR				(*((uint32_t*)(0x40004400)))	//

// Define the NVIC registers
#define NVIC_BASE		0xE000E100	//
#define NVIC_ISER1		(*((uint32_t*)(NVIC_BASE + 0x04)))	//

/* USER CODE END PD */

void SystemClock_Config(void);
static void MX_GPIO_Init(void);
/* USER CODE BEGIN PFP */
char chrRXBuf[32];
uint8_t u8Index = 0;
/* USER CODE END PFP */

/* USER CODE BEGIN 0 */
void uart2_init()
{
	__HAL_RCC_GPIOA_CLK_ENABLE();		// Enable clock for GPIOD
	GPIOA_MODER |= (2U << 4) | (2U << 6); // PA2, PA3 as Alternate function mode
	GPIOA_AFRL &= ~(0xFFU << 8);
	GPIOA_AFRL |= (7U << 8) | (7U << 12);

	__HAL_RCC_USART2_CLK_ENABLE();
	BRR = (104U << 4) | (3U << 0);
	CR1 |= (1U << 3) | (1U << 2) | (1U << 13);

	CR1 |= (1U << 5);			// Enable RXNEIE bit to general interrupt
	NVIC_ISER1 |= (1U << 6);	// Enable USART2 reception

}

void uartSend1Byte(uint8_t data)
{
	while (((SR >> 7)&1) != 1);
	DR = data;
	while (((SR >> 6)&1) != 1);

}

void uartRecvByte(char *buff, int size)
{
	/*
	 * To do:
	 * 1. Read bit RXNE (bit 5 in Status register (USART_SR)).
	 *
	 */

	for (int i = 0; i < size; i++)
	{
		while(((SR >> 5) & 1) == 0); // Cho o day khi nhan du du lieu (bit RXNE duoc set len 1)
			buff[i] = DR;
	}
}

void USART2_IRQHandler()
{
	chrRXBuf[u8Index++] = DR;
	if (u8Index >= 31U){
		u8Index = 0;
	}
}
/* USER CODE END 0 */

int main(void)
{

  /* MCU Configuration--------------------------------------------------------*/

  /* Reset of all peripherals, Initializes the Flash interface and the Systick. */
  HAL_Init();

  /* Configure the system clock */
  SystemClock_Config();

  /* Initialize all configured peripherals */
  MX_GPIO_Init();

  /* Infinite loop */
  /* USER CODE BEGIN WHILE */
  uart2_init();
//  uint8_t hello_msg[] = "hello\r\n";

  while (1);

}

void SystemClock_Config(void)
{
  RCC_OscInitTypeDef RCC_OscInitStruct = {0};
  RCC_ClkInitTypeDef RCC_ClkInitStruct = {0};

  /** Configure the main internal regulator output voltage
  */
  __HAL_RCC_PWR_CLK_ENABLE();
  __HAL_PWR_VOLTAGESCALING_CONFIG(PWR_REGULATOR_VOLTAGE_SCALE1);

  /** Initializes the RCC Oscillators according to the specified parameters
  * in the RCC_OscInitTypeDef structure.
  */
  RCC_OscInitStruct.OscillatorType = RCC_OSCILLATORTYPE_HSI;
  RCC_OscInitStruct.HSIState = RCC_HSI_ON;
  RCC_OscInitStruct.HSICalibrationValue = RCC_HSICALIBRATION_DEFAULT;
  RCC_OscInitStruct.PLL.PLLState = RCC_PLL_NONE;
  if (HAL_RCC_OscConfig(&RCC_OscInitStruct) != HAL_OK)
  {
    Error_Handler();
  }

  /** Initializes the CPU, AHB and APB buses clocks
  */
  RCC_ClkInitStruct.ClockType = RCC_CLOCKTYPE_HCLK|RCC_CLOCKTYPE_SYSCLK
                              |RCC_CLOCKTYPE_PCLK1|RCC_CLOCKTYPE_PCLK2;
  RCC_ClkInitStruct.SYSCLKSource = RCC_SYSCLKSOURCE_HSI;
  RCC_ClkInitStruct.AHBCLKDivider = RCC_SYSCLK_DIV1;
  RCC_ClkInitStruct.APB1CLKDivider = RCC_HCLK_DIV1;
  RCC_ClkInitStruct.APB2CLKDivider = RCC_HCLK_DIV1;

  if (HAL_RCC_ClockConfig(&RCC_ClkInitStruct, FLASH_LATENCY_0) != HAL_OK)
  {
    Error_Handler();
  }
}

static void MX_GPIO_Init(void)
{

  /* GPIO Ports Clock Enable */
  __HAL_RCC_GPIOA_CLK_ENABLE();

}

void Error_Handler(void)
{
  __disable_irq();
  while (1)
  {
  }
}
